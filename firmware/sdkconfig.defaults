## firmware/sdkconfig.defaults
```kconfig
# Insight Profiler — ESP32-S3 SDK Configuration Defaults
# EmbedLab-Tech

# Target
CONFIG_IDF_TARGET="esp32s3"

# USB — Use native USB peripheral (not UART bridge)
CONFIG_TINYUSB=y
CONFIG_TINYUSB_CDC_ENABLED=y
CONFIG_TINYUSB_CDC_RX_BUFSIZE=512
CONFIG_TINYUSB_CDC_TX_BUFSIZE=512

# Console — Route logs to UART0 (keep USB for data)
CONFIG_ESP_CONSOLE_UART_DEFAULT=y

# FreeRTOS
CONFIG_FREERTOS_HZ=1000

# Flash
CONFIG_ESPTOOLPY_FLASHSIZE_4MB=y

# CPU Frequency
CONFIG_ESP_DEFAULT_CPU_FREQ_MHZ_240=y

# Compiler — Enable C++ exceptions
CONFIG_COMPILER_CXX_EXCEPTIONS=y
```
